## firmware_custom/recorder_mvp/sdkconfig.defaults
```kconfig
CONFIG_TINYUSB_MSC_ENABLED=y
CONFIG_FATFS_LFN_HEAP=y
CONFIG_COMPILER_OPTIMIZATION_PERF=y
CONFIG_ESP_DEFAULT_CPU_FREQ_MHZ_240=y
CONFIG_LOG_DEFAULT_LEVEL_WARN=y
CONFIG_SPIRAM=y
CONFIG_SPIRAM_MODE_OCT=y
CONFIG_SPIRAM_SPEED_80M=y
CONFIG_SPIRAM_MALLOC_ALWAYSINTERNAL=1024
CONFIG_SPIRAM_MALLOC_RESERVE_INTERNAL=131072

CONFIG_LVGL_INPUT_DEVICE_USE_KNOB=y
CONFIG_LVGL_INPUT_DEVICE_USE_TP=n
CONFIG_LVGL_INPUT_DEVICE_SENSITIVITY=20
CONFIG_LVGL_PORT_TASK_MAX_SLEEP_MS=100
CONFIG_LVGL_PORT_TIMER_PERIOD_MS=5
CONFIG_BSP_LCD_DEFAULT_BRIGHTNESS=70
```

## firmware_custom/standby_battery_minimal/sdkconfig.defaults
```kconfig
CONFIG_IDF_TARGET="esp32s3"
CONFIG_ESPTOOLPY_FLASHSIZE_32MB=y
CONFIG_SPIRAM=y
CONFIG_SPIRAM_MODE_OCT=y
CONFIG_SPIRAM_SPEED_80M=y

CONFIG_BSP_LCD_DEFAULT_BRIGHTNESS=0
CONFIG_BSP_LCD_PANEL_SPI_TRANS_Q_DEPTH=1
CONFIG_BSP_LCD_SPI_DMA_SIZE_DIV=8

CONFIG_LVGL_DRAW_BUFF_HEIGHT=40
CONFIG_LVGL_INPUT_DEVICE_USE_KNOB=n
CONFIG_LVGL_INPUT_DEVICE_USE_TP=n
CONFIG_LVGL_PORT_TASK_MAX_SLEEP_MS=1000
CONFIG_LVGL_PORT_TIMER_PERIOD_MS=20

CONFIG_LV_COLOR_16_SWAP=y
CONFIG_LV_FONT_MONTSERRAT_20=y
CONFIG_LV_FONT_MONTSERRAT_48=y

CONFIG_LOG_DEFAULT_LEVEL_WARN=y
CONFIG_BOOTLOADER_LOG_LEVEL_WARN=y

CONFIG_COMPILER_OPTIMIZATION_SIZE=y
```
